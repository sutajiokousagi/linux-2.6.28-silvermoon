## src/arch/arm/mach-mmp/Kconfig
```kconfig
if ARCH_MMP

menu "Marvell PXA168 Implmentations"

config MACH_ASPENITE
	bool "Marvell's PXA168 Aspenite Development Board"
	select CPU_PXA168
	help
	  Say 'Y' here if you want to support the Marvell PXA168-based
	  Aspenite Development Board.

config MACH_CHUMBY_SILVERMOON
	bool "Chumby Silvermoon"
	select BOARD_CHUMBY_SILVERMOON
	depends on CPU_PXA168

config GENERIC_TIME
	bool "Generic time (pxa168)"
	default y
	help
	  Say 'N' here for Chumby Silvermoon. Recent BSP drops have
	  CONFIG_GENERIC_TIME turned on for the entire MMP (pxa168)
	  family. We need it off.

config CHUMBY_800_480_VIDEO
       bool "Use 800 by 480 screen instead of 800 by 600 screen"
	depends on MACH_CHUMBY_SILVERMOON
       default n

config CHUMBY_SILVERMOON_SDBOOT
	bool "Chumby Silvermoon board with microSD boot option"
	select CHUMBY_SILVERMOON_MMC2_WIFI
	depends on MACH_CHUMBY_SILVERMOON
	default n
	help
	  Say 'Y' here if this is one of the newer Chumby Silvermoon
	  boards spun in July 2009 which have the CPU on a riser
	  card and a microSD slot for embedded SD boot

config CHUMBY_SILVERMOON_A0
	bool "Chumby Silvermoon board with early A0 stepping"
	depends on MACH_CHUMBY_SILVERMOON
	default n
	help
	  Say 'Y' here if this is an actual A0 stepping of the
	  PXA168.

config CHUMBY_SILVERMOON_MMC2_WIFI
	bool "Chumby Silvermoon board with wifi on MMC2"
	depends on MACH_CHUMBY_SILVERMOON
	default n
	help
	  Say 'Y' here only if you have not selected the eSD option
	  (CHUMBY_SILVERMOON_SDBOOT) but want to enable wifi on MMC2
	  (similar to the Aspenite board) rather than on MMC3 as it
	  was with older (pre-July 2009) hardware revs of the Chumby
	  Silvermoon board.

config MACH_WAYLAND
	bool "Marvell's PXA168 Wayland Development Board"
	select CPU_PXA168
 	help
	  Say 'Y' here if you want to support the Marvell PXA168-based
	  Wayland Development Board.

config MACH_ZYLONITE2
	bool "Marvell's PXA168 Zylonite2 Development Board"
	select CPU_PXA168
	help
	  Say 'Y' here if you want to support the Marvell PXA168-based
	  Zylonite2 Development Board.

config MACH_TETON_BGA
        bool "Marvell's PXA168 Teton BGA Development Board"
        select CPU_PXA168
        help
          Say 'Y' here if you want to support the Marvell PXA168-based
          Teton BGA Development Board.

config MACH_TTC_DKB
	bool "Marvell's PXA910 TTC_DKB Development Board"
	select CPU_PXA910
	select CPU_PXA168
	help
	  Say 'Y' here if you want to support the Marvell PXA910-based
	  TTC_DKB Development Board.

config MACH_TAVOREVB
	bool "PXA910 Evaluation Board (aka TavorEVB)"
	select CPU_PXA910
	select CPU_PXA168
	help
	  Say 'Y' here if you want to support the Marvell PXA910-based
	  TavorEVB Development Board.

endmenu

config GLOBAL_PREEMPT_NOTIFIERS
	bool "Enable global preempt notifier"
	depends on PREEMPT_NOTIFIERS
	default y

config CPU_PXA168
	bool
	select CPU_MOHAWK
	select PREEMPT_NOTIFIERS
	help
	  Select code specific to PXA168

config CPU_PXA910
	bool
	select CPU_MOHAWK
	select PREEMPT_NOTIFIERS
	help
	  Select code specific to PXA910

config TIMER_SERVICES_MMP
	bool "timer services on MMP"
	help
	  Provide high resolution timer services

endif
```

## src/sound/soc/pxa/Kconfig
```kconfig
menu "SoC Audio for the Intel PXA2xx"
config SND_PXA2XX_SOC
	tristate "SoC Audio for the Intel PXA2xx chip"
	depends on ARCH_PXA
	select SND_PXA2XX_LIB
	help
	  Say Y or M if you want to add support for codecs attached to
	  the PXA2xx AC97, I2S or SSP interface. You will also need
	  to select the audio interfaces to support below.

config SND_PXA2XX_AC97
	tristate
	select SND_AC97_CODEC

config SND_PXA2XX_SOC_AC97
	tristate
	select AC97_BUS
	select SND_ARM
	select SND_PXA2XX_LIB_AC97
	select SND_SOC_AC97_BUS

config SND_PXA2XX_SOC_I2S
	tristate

config SND_PXA2XX_SOC_CORGI
	tristate "SoC Audio support for Sharp Zaurus SL-C7x0"
	depends on SND_PXA2XX_SOC && PXA_SHARP_C7xx
	select SND_PXA2XX_SOC_I2S
	select SND_SOC_WM8731
	help
	  Say Y if you want to add support for SoC audio on Sharp
	  Zaurus SL-C7x0 models (Corgi, Shepherd, Husky).

config SND_PXA2XX_SOC_SPITZ
	tristate "SoC Audio support for Sharp Zaurus SL-Cxx00"
	depends on SND_PXA2XX_SOC && PXA_SHARP_Cxx00
	select SND_PXA2XX_SOC_I2S
	select SND_SOC_WM8750
	help
	  Say Y if you want to add support for SoC audio on Sharp
	  Zaurus SL-Cxx00 models (Spitz, Borzoi and Akita).

config SND_PXA2XX_SOC_POODLE
	tristate "SoC Audio support for Poodle"
	depends on SND_PXA2XX_SOC && MACH_POODLE
	select SND_PXA2XX_SOC_I2S
	select SND_SOC_WM8731
	help
	  Say Y if you want to add support for SoC audio on Sharp
	  Zaurus SL-5600 model (Poodle).

config SND_PXA2XX_SOC_TOSA
	tristate "SoC AC97 Audio support for Tosa"
	depends on SND_PXA2XX_SOC && MACH_TOSA
	depends on MFD_TC6393XB
	select SND_PXA2XX_SOC_AC97
	select SND_SOC_WM9712
	help
	  Say Y if you want to add support for SoC audio on Sharp
	  Zaurus SL-C6000x models (Tosa).

config SND_PXA2XX_SOC_E800
	tristate "SoC AC97 Audio support for e800"
	depends on SND_PXA2XX_SOC && MACH_E800
	select SND_SOC_WM9712
	select SND_PXA2XX_SOC_AC97
	help
	  Say Y if you want to add support for SoC audio on the
	  Toshiba e800 PDA

config SND_PXA2XX_SOC_EM_X270
	tristate "SoC Audio support for CompuLab EM-x270"
	depends on SND_PXA2XX_SOC && MACH_EM_X270
	select SND_PXA2XX_SOC_AC97
	select SND_SOC_WM9712
	help
	  Say Y if you want to add support for SoC audio on
	  CompuLab EM-x270.

endmenu

menu "SoC Audio for the Intel PXA3xx"
config SND_PXA3XX_SOC
	tristate "SoC Audio for the Intel PXA3xx chip"
	depends on ARCH_MMP && SND
	select SND_PCM
	help
	  Say Y or M if you want to add support for codecs attached to
	  the PXA3xx AC97, I2S or SSP interface. You will also need
	  to select the audio interfaces to support below.

config SND_PXA3XX_SOC_SSP
	tristate "Soc Audio for the Intel PXA3xx SSP interface"
	depends on ARCH_MMP && SND
        help
	  Say Y or M if you want to add support for PXA3xx ssp interface.


config SND_PXA3XX_SOC_ZYLONITE2
        bool "SoC Audio support for ZYLONITE2"
	depends on SND_PXA3XX_SOC && MACH_ZYLONITE2
	select SND_SOC_WM8753
	help
	  Say Y if you want to add support for SoC audio on ZYLONITE2

config SND_PXA3XX_SOC_ASPENITE
        bool "SoC Audio support for Aspenite"
	depends on SND_PXA3XX_SOC && MACH_ASPENITE
	select SND_SOC_WM8753
	help
	  Say Y if you want to add support for SoC audio on ZYLONITE2

config SND_PXA3XX_SOC_SILVERMOON
        tristate "SoC Audio support for Silvermoon"
	depends on SND_PXA3XX_SOC && MACH_ASPENITE
	select SND_SOC_WM8961
	help
	  Say Y if you want to add support for SoC audio on Silvermoon

config SND_PXA3XX_SOC_SILVERMOON_DEBUG
        bool "Verbose debugging for Silvermoon SOC audio driver"
        depends on SND_PXA3XX_SOC_SILVERMOON
        help
            Say Y if you want extra verbose debugging specific to the
            Silvermoon audio driver

config SND_PXA3XX_SOC_TETON_BGA
        bool "SoC Audio support for Teton BGA"
	depends on SND_PXA3XX_SOC && MACH_TETON_BGA
        select SND_SOC_CS4344
        help
          Say Y if you want to add support for SoC audio on Teton
          with the CS4344 DAC.

endmenu

menu "SoC Audio for the Marvell PXA910"
config SND_PXA910_SOC
	tristate "SoC Audio for the Marvell PXA910 chip"
	depends on ARCH_MMP && SND
	select SND_PCM
	select SND_PXA3XX_SOC_SSP
	help
	  Say Y or M if you want to add support for codecs attached to
	  the PXA3xx AC97, I2S or SSP interface. You will also need
	  to select the audio interfaces to support below.


config SND_PXA910_SOC_TTC_DKB
        bool "SoC Audio support for TTC DKB"
	depends on SND_PXA910_SOC && MACH_TTC_DKB
	select SND_SOC_SANREMO_AUDIO
	help
	  Say Y if you want to add support for SoC audio on TTC DKB

config SND_PXA910_SOC_TAVOREVB
        bool "SoC Audio support for Tavorevb"
	depends on SND_PXA910_SOC && MACH_TAVOREVB
	select SND_SOC_MICCO
	help
	  Say Y if you want to add support for SoC audio on Tavorevb
endmenu
```
